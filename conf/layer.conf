## conf/layer.conf
```bitbake
# We have a conf and classes directory, add to BBPATH
BBPATH .= ":${LAYERDIR}"

# We have a packages directory, add to BBFILES
BBFILES += "${LAYERDIR}/recipes-*/*/*.bb \
            ${LAYERDIR}/recipes-*/*/*.bbappend"

BBFILE_COLLECTIONS += "bsp-vdt6010-layer"
BBFILE_PATTERN_bsp-vdt6010-layer := "^${LAYERDIR}/"
BBFILE_PRIORITY_bsp-vdt6010-layer = "6"

LAYERDEPENDS_bsp-vdt6010-layer = "core freescale-layer bsp-common-layer"
LAYERSERIES_COMPAT_bsp-vdt6010-layer = "zeus"

# Let us add layer-specific bbappends which are only applied when that
# layer is included in our configuration
BBFILES += "${@' '.join('${LAYERDIR}/%s/recipes*/*/*.bbappend' % layer \
               for layer in BBFILE_COLLECTIONS.split())}"
               
```

## conf/machine/upstream.conf
```bitbake
require vdt6010.conf

PREFERRED_PROVIDER_virtual/kernel = "upstream-dr"

MACHINE_FEATURES_remove = "screen bluetooth"
```

## conf/machine/vdt6010-factory.conf
```bitbake
#@TYPE: Machine
#@NAME: i.MX6Q Data Respons VDT6010
#@DESCRIPTION: Factory Machine configuration for VDT6010
#@SOC: i.MX6Q

require vdt6010.conf

MACHINEOVERRIDES =. "factory:"

DISTRO = "factory-distro"

MACHINE_ESSENTIAL_EXTRA_RDEPENDS += "factory-install"

FACTORY_IMAGE_INSTALL = "\
	kernel-image \
	devicetree \
	u-boot \
"

FACTORY_DEVICETREE = "vdt6010-q-revA.dtb"
```

## conf/machine/vdt6010-mainline.conf
```bitbake
require vdt6010.conf

PREFERRED_PROVIDER_virtual/bootloader = "u-boot"
PREFFERED_VERSION_u-boot-dr = "2019.04"
```

## conf/machine/vdt6010.conf
```bitbake
#@TYPE: Machine
#@NAME: i.MX6Q Data Respons VDT6010
#@DESCRIPTION: Machine configuration for VDT6010
#@SOC: i.MX6Q

MACHINEOVERRIDES =. "mx6:mx6q:mx6dl:use-mainline-bsp:"

require conf/machine/include/imx-base.inc
require conf/machine/include/tune-cortexa9.inc

DISTRO ?= "datarespons-distro"

SYSTEM_NAME="VDT6010"

IMAGE_FSTYPES = "tar.bz2"
INITRAMFS_MAXSIZE = "400000"
INITRAMFS_FSTYPES = "cpio.gz.u-boot"

SERIAL_CONSOLES = "115200;ttymxc4"

UBOOT_CONFIG ??= "production"
UBOOT_CONFIG[production] = "vdt6010_defconfig"
UBOOT_MAKE_TARGET = ""

MACHINE_FEATURES = "rtc pci wifi 3g bluetooth ext2 vfat usbgadget usbhost screen touchscreen"
MACHINE_ESSENTIAL_EXTRA_RDEPENDS += "devicetree"
MACHINE_ESSENTIAL_EXTRA_RRECOMMENDS += "nvram kernel-modules kernel-module-bmc kernel-module-user-gpios kernel-module-fsl-otp"
MACHINE_EXTRA_RRECOMMENDS += "flash-uboot"

NVRAM_INTERFACE ?= "mtd"
NVRAM_MTD_WP ?= "101"

PREFERRED_PROVIDER_virtual/bootloader = "u-boot"
PREFFERED_VERSION_u-boot-dr = "2019.04"

PREFERRED_PROVIDER_virtual/kernel = "linux-mainline"
PREFERRED_VERSION_linux-mainline = "5.4.%"

KERNEL_IMAGETYPE = "zImage"
# meta-freescale breaks build due to hard dependency for KERNEL_DEVICETREE.
# We remove the the dependency to allow building devicetree out-of-tree.
IMAGE_BOOT_FILES = "${KERNEL_IMAGETYPE}"

VOLATILE_LOG_DIR="no"
```
